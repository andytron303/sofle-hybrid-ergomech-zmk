## boards/shields/solfe_ergomech_dongle/kconfig.shield
```kconfig
# No whitespace after the comma or in the keyboard name!
config SHIELD_SOFLE_ERGOMECH_DONGLE
    def_bool $(shields_list_contains,my_keyboard_dongle)
```
